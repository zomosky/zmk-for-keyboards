## config/west.yml
```yaml
manifest:
  remotes:
    - name: zmkfirmware
      url-base: https://github.com/zmkfirmware
      #url-base: https://github.com/mozixun-me
    - name: petejohanson
      url-base: https://github.com/petejohanson
  projects:
    - name: zmk
    #- name: zmk-bongo-cat
      remote: zmkfirmware
      revision: main
      #revision: bongo-cat
      import: app/west.yml
  self:
    path: config
```
